## dev_minihub/dev_minihub/main/Kconfig.projbuild
```kconfig
menu "Rogo Configuration"

    choice BLE_MESH_EXAMPLE_BOARD
        prompt "Board selection"
        default ESP_WROOM_32 if IDF_TARGET_ESP32
        default ESP32C3_DEV if IDF_TARGET_ESP32C3
        default ESP32S3_DEV if IDF_TARGET_ESP32S3
        help
            Select this option to choose the board for BLE Mesh. The default is ESP32-WROOM-32

        config ESP_WROOM_32
            bool "ESP32-WROOM-32"
            depends on IDF_TARGET_ESP32

        config ESP_WROVER
            bool "ESP32-WROVER"
            depends on IDF_TARGET_ESP32

        config ESP32C3_DEV
            bool "ESP32C3-DevKitC"
            depends on IDF_TARGET_ESP32C3
        
        config ESP32C3_RADAR_DEV
            bool "ESP32C3-Radar"
            depends on IDF_TARGET_ESP32C3

        config BESP32S3_DEV
            bool "ESP32S3-DevKitC"
            depends on IDF_TARGET_ESP32S3
    endchoice

    menu "Device Configuration"      
        
    endmenu

    menu "WILE Configuration"
        config WILE_ENABLE
            bool "Enable WiLe"
            default y

        config DEVICE_NAME
            string "Device product ID"
            default "WILE_DEV"
            depends on WILE_ENABLE
    endmenu

    # menu "OTA Configuration"
    #     config OTA_ENABLE
    #         bool "Enable OTA"
    #         default n
    
    #     config OTA_SKIP_COMMON_NAME_CHECK
    #         bool "Skip server certificate CN fieldcheck"
    #         default n
    #         depends on OTA_ENABLE
    #         help
    #             This allows you to skip the validation of OTA server certificate CN field.
    
    #     config OTA_SKIP_VERSION_CHECK
    #         bool "Skip firmware version check"
    #         default n
    #         depends on OTA_ENABLE
    #         help
    #             This allows you to skip the firmware version check.
    
    #     config OTA_RECV_TIMEOUT
    #         int "OTA Receive Timeout"
    #         default 5000
    #         depends on OTA_ENABLE
    #         help
    #             Maximum time for reception
    
    #     config OTA_ENABLE_PARTIAL_HTTP_DOWNLOAD
    #         bool "Enable partial HTTP download"
    #         default n
    #         depends on OTA_ENABLE
    #         help
    #             This enables use of Range header in esp_https_ota component.
    #             Firmware image will be downloaded over multiple HTTP requests.
    
    #     config OTA_HTTP_REQUEST_SIZE
    #         int "HTTP request size"
    #         default MBEDTLS_SSL_IN_CONTENT_LEN
    #         depends on EXAMPLE_ENABLE_PARTIAL_HTTP_DOWNLOAD
    #         depends on OTA_ENABLE
    #         help
    #             This options specifies HTTP request size. Number of bytes specified
    #             in this option will be downloaded in single HTTP request.
    # endmenu

endmenu
```
